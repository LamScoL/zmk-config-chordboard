/ {
	chosen {
		zmk,kscan = &default_kscan;
	};

	default_kscan: kscan {
		compatible = "zmk,kscan-gpio-direct";
		label = "default_kscan";

		input-gpios =
			<&pro_micro (GPIO_ACTIVE_HIGH | GPIO_PULL_DOWN)>,
			<&pro_micro (GPIO_ACTIVE_HIGH | GPIO_PULL_DOWN)>,
			<&pro_micro (GPIO_ACTIVE_HIGH | GPIO_PULL_DOWN)>,
			<&pro_micro (GPIO_ACTIVE_HIGH | GPIO_PULL_DOWN)>,
			<&pro_micro (GPIO_ACTIVE_HIGH | GPIO_PULL_DOWN)>,
			<&pro_micro 19 (GPIO_ACTIVE_HIGH | GPIO_PULL_DOWN)>;
	};
};
