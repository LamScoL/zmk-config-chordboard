#include <behaviors.dtsi>
#include <dt-bindings/zmk/keys.h>

/ {
    keymap {
        compatible = "zmk,keymap";

        default_layer {
            bindings = <
    &kp 1    &kp 2    &kp 3    &kp 4     &kp 5     &kp 6

            >;
        };
    };
};